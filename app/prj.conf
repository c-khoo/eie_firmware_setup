## prj.conf
```kconfig
# Copyright (c) 2021 Nordic Semiconductor ASA
# SPDX-License-Identifier: Apache-2.0
#
# This file contains selected Kconfig options for the application.

CONFIG_GPIO=y
CONFIG_PWM=y
CONFIG_SMF=y
CONFIG_SYSTEM_WORKQUEUE_STACK_SIZE=2048
CONFIG_BT=y
CONFIG_BT_PERIPHERAL=y
CONFIG_BT_DEVICE_NAME="7640 EiE BLE Peripheral"
```

## src/main.c
```c
/*
 * main.c
 */

#include <inttypes.h>

#include <zephyr/kernel.h>
#include <zephyr/sys/printk.h>

#include "BTN.h"
#include "LED.h"

#include <stdio.h>
#include <string.h>
#include <zephyr/bluetooth/bluetooth.h>
#include <zephyr/bluetooth/conn.h>
#include <zephyr/bluetooth/gatt.h>
#include <zephyr/bluetooth/hci.h>
#include <zephyr/bluetooth/uuid.h>
#include <zephyr/device.h>
#include <zephyr/devicetree.h>
#include <zephyr/drivers/display.h>
#include <zephyr/drivers/gpio.h>
#include <zephyr/kernel.h>
#include <zephyr/settings/settings.h>
#include <zephyr/sys/printk.h>

#define SLEEP_MS 1
#define BLE_CUSTOM_SERVICE_UUID BT_UUID_128_ENCODE(0x12345678, 0x1234, 0x5678, 0x1234, 0x56789abcdef0)
#define BLE_CUSTOM_CHARACTERISTIC_UUID BT_UUID_128_ENCODE(0x12345678, 0x1234, 0x5678, 0x1234, 0x56789abcdef2)
#define BLE_SECOND_CHARACTERISTIC_UUID BT_UUID_128_ENCODE(0x12345678, 0x1234, 0x5678, 0x1234, 0x56789abcdef4)
#define BLE_CUSTOM_CHARACTERISTIC_MAX_DATA_LENGTH 20

static const struct bt_data ble_advertising_data[] = {
  BT_DATA_BYTES(BT_DATA_FLAGS, (BT_LE_AD_GENERAL | BT_LE_AD_NO_BREDR)),
  BT_DATA(BT_DATA_NAME_COMPLETE, CONFIG_BT_DEVICE_NAME, sizeof(CONFIG_BT_DEVICE_NAME)),
};

// static uint8_t ble_custom_characteristic_user_data[20] = {};   // not needed for challenge 2
static uint8_t ble_second_characteristic_user_data[20] = {};

static ssize_t ble_custom_characteristic_read_cb(struct bt_conn* conn, const struct bt_gatt_attr* attr,
                                                 void* buf, uint16_t len, uint16_t offset) {
  const char* value = attr->user_data;
  return bt_gatt_attr_read(conn, attr, buf, len, offset, value, strlen(value));
}

static ssize_t ble_custom_characteristic_write_cb(struct bt_conn* conn, const struct bt_gatt_attr* attr,
                                                  const void* buf, uint16_t len, uint16_t offset,
                                                  uint8_t flags) {
  uint8_t* value_ptr = attr->user_data;

  if (offset + len > BLE_CUSTOM_CHARACTERISTIC_MAX_DATA_LENGTH) {
    return BT_GATT_ERR(BT_ATT_ERR_INVALID_OFFSET);
  }

  memcpy(value_ptr + offset, buf, len);
  value_ptr[offset + len] = 0;

  return len;
}

static const struct bt_uuid_128 ble_custom_service_uuid = BT_UUID_INIT_128(BLE_CUSTOM_SERVICE_UUID);
static const struct bt_uuid_128 ble_custom_characteristic_uuid = BT_UUID_INIT_128(BLE_CUSTOM_CHARACTERISTIC_UUID);
static const struct bt_uuid_128 ble_second_characteristic_uuid = BT_UUID_INIT_128(BLE_SECOND_CHARACTERISTIC_UUID);

BT_GATT_SERVICE_DEFINE(
    ble_custom_service,  // Name of the struct that will store the config for this service
    BT_GATT_PRIMARY_SERVICE(&ble_custom_service_uuid),  // Setting the service UUID
    BT_GATT_CHARACTERISTIC(
        &ble_custom_characteristic_uuid.uuid,  // Setting the characteristic UUID
        BT_GATT_CHRC_READ,  // Possible operations
        BT_GATT_PERM_READ,  // Permissions that connecting devices have
        ble_custom_characteristic_read_cb,     // Callback for when this characteristic is read from
        ble_custom_characteristic_write_cb,    // Callback for when this characteristic is written to
        ble_second_characteristic_user_data    // Initial data stored in this characteristic
        ),
    BT_GATT_CHARACTERISTIC(
        &ble_second_characteristic_uuid.uuid,  // Setting the characteristic UUID
        BT_GATT_CHRC_WRITE,  // Possible operations
        BT_GATT_PERM_WRITE,  // Permissions that connecting devices have
        ble_custom_characteristic_read_cb,     // Callback for when this characteristic is read from
        ble_custom_characteristic_write_cb,    // Callback for when this characteristic is written to
        ble_second_characteristic_user_data    // Initial data stored in this characteristic
        ),
);

int main(void) {

  if (0 > BTN_init()) {
    return 0;
  }
  if (0 > LED_init()) {
    return 0;
  }

  int err = bt_enable(NULL);
  if (err) {
    printk("Bluetooth init failed (err %d)\n", err);
    return 0;
  } else {
    printk("Bluetooth initialized!\n");
  }

  err = bt_le_adv_start(BT_LE_ADV_CONN_FAST_1, ble_advertising_data, ARRAY_SIZE(ble_advertising_data), NULL, 0);
  if (err) {
    printk("Advertising failed (err %d)\n", err);
    return 0;
  } else {
    printk("Advertising started!\n");
  }

  while(1) {
    k_msleep(SLEEP_MS);
  }
	return 0;
}
```

## src/my_state_machine.c
```c
/**
 * @file my_state_machine.c
 */

#include <zephyr/smf.h>

#include "LED.h"
#include "BTN.h"
#include "my_state_machine.h"

/*----------------------------------------------------------------
 * Function Prototypes
 *--------------------------------------------------------------*/
static void s0_state_entry(void* o);
static enum smf_state_result s0_state_run(void* o);
static void s0_state_exit(void* o);
static void s1_state_entry(void* o);
static enum smf_state_result s1_state_run(void* o);
static void s1_state_exit(void* o);
static void s2_state_entry(void* o);
static enum smf_state_result s2_state_run(void* o);
static void s2_state_exit(void* o);
static void s3_state_entry(void* o);
static enum smf_state_result s3_state_run(void* o);
static void s3_state_exit(void* o);
static void s4_state_entry(void* o);
static enum smf_state_result s4_state_run(void* o);
static void s4_state_exit(void* o);

/*----------------------------------------------------------------
 * Typedefs
 *--------------------------------------------------------------*/
enum led_state_machine_states {
    S0,
    S1,
    S2,
    S3,
    S4
};

typedef struct {
    // context variable used by zephyr to track machine state. Must be first
    struct smf_ctx ctx;

    uint16_t count;
} led_state_object_t;

/*----------------------------------------------------------------
 * Local Variables
 *--------------------------------------------------------------*/
static const struct smf_state led_states[] = {
    [S0] = SMF_CREATE_STATE(s0_state_entry, s0_state_run, s0_state_exit, NULL, NULL),
    [S1] = SMF_CREATE_STATE(s1_state_entry, s1_state_run, s1_state_exit, NULL, NULL),
    [S2] = SMF_CREATE_STATE(s2_state_entry, s2_state_run, s2_state_exit, NULL, NULL),
    [S3] = SMF_CREATE_STATE(s3_state_entry, s3_state_run, s3_state_exit, NULL, NULL),
    [S4] = SMF_CREATE_STATE(s4_state_entry, s4_state_run, s4_state_exit, NULL, NULL)
};

static led_state_object_t led_state_object;

void state_machine_init() {
    led_state_object.count = 0;
    smf_set_initial(SMF_CTX(&led_state_object), &led_states[S0]);
}

int state_machine_run() {
    return smf_run_state(SMF_CTX(&led_state_object));
}

static void s0_state_entry(void* o) {
    printk("Entering S0\n");
    LED_set(LED0, LED_OFF);
    LED_set(LED1, LED_OFF);
    LED_set(LED2, LED_OFF);
    LED_set(LED3, LED_OFF);
}

static enum smf_state_result s0_state_run(void* o) {
    if (BTN_is_pressed(BTN0)) {
        smf_set_state(SMF_CTX(&led_state_object), &led_states[S1]);
    }

    return SMF_EVENT_HANDLED;
}

static void s0_state_exit(void* o) {
    printk("Exiting S0\n");
}

static void s1_state_entry(void* o) {
    printk("Entering S1\n");
    LED_set(LED0, LED_ON);
}

static enum smf_state_result s1_state_run(void* o) {
    if (BTN_is_pressed(BTN2)) {
        smf_set_state(SMF_CTX(&led_state_object), &led_states[S4]);
    } else if (BTN_is_pressed(BTN1)) {
        smf_set_state(SMF_CTX(&led_state_object), &led_states[S2]);
    } else if (BTN_is_pressed(BTN3)) {
        smf_set_state(SMF_CTX(&led_state_object), &led_states[S0]);
    } else if (led_state_object.count > 125) {
        led_state_object.count = 0;
        LED_toggle(LED0);
    } else {
        led_state_object.count++;
    }

    return SMF_EVENT_HANDLED;
}

static void s1_state_exit(void* o) {
    printk("Exiting S1\n");
    led_state_object.count = 0;
}

static void s2_state_entry(void* o) {
    printk("Entering S2\n");
    LED_set(LED0, LED_ON);
    LED_set(LED1, LED_OFF);
    LED_set(LED2, LED_ON);
    LED_set(LED3, LED_OFF);
}

static enum smf_state_result s2_state_run(void* o) {
    if (BTN_is_pressed(BTN3)) {
        smf_set_state(SMF_CTX(&led_state_object), &led_states[S0]);
    } else if (led_state_object.count > 1000) {
        led_state_object.count = 0;
        smf_set_state(SMF_CTX(&led_state_object), &led_states[S3]);
    } else {
        led_state_object.count++;
    }

    return SMF_EVENT_HANDLED;
}

static void s2_state_exit(void* o) {
    printk("Exiting S2\n");
    led_state_object.count = 0;
}

static void s3_state_entry(void* o) {
    printk("Entering S3\n");
    LED_set(LED0, LED_OFF);
    LED_set(LED1, LED_ON);
    LED_set(LED2, LED_OFF);
    LED_set(LED3, LED_ON);
}

static enum smf_state_result s3_state_run(void* o) {
    if (BTN_is_pressed(BTN3)) {
        smf_set_state(SMF_CTX(&led_state_object), &led_states[S0]);
    } else if (led_state_object.count > 2000) {
        led_state_object.count = 0;
        smf_set_state(SMF_CTX(&led_state_object), &led_states[S2]);
    } else {
        led_state_object.count++;
    }

    return SMF_EVENT_HANDLED;
}

static void s3_state_exit(void* o) {
    printk("Exiting S3\n");
    led_state_object.count = 0;
}

static void s4_state_entry(void* o) {
    printk("Entering S4\n");
    LED_set(LED0, LED_ON);
    LED_set(LED1, LED_ON);
    LED_set(LED2, LED_ON);
    LED_set(LED3, LED_ON);
}

static enum smf_state_result s4_state_run(void* o) {
    if (BTN_is_pressed(BTN3)) {
        smf_set_state(SMF_CTX(&led_state_object), &led_states[S0]);
    } else if (led_state_object.count > 32) {
        led_state_object.count = 0;
        LED_toggle(LED0);
        LED_toggle(LED1);
        LED_toggle(LED2);
        LED_toggle(LED3);
    } else {
        led_state_object.count++;
    }

    return SMF_EVENT_HANDLED;
}

static void s4_state_exit(void* o) {
    printk("Exiting S4\n");
    led_state_object.count = 0;
}
```
